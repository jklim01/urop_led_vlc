/*
	This file was auto-generated by "filter_params_generator_nicer.m".
	It contains the filter coefficients for an rrc filter (parameters listed below).
*/

#ifndef VAR_DECL
#error "The declaration of the variable (VAR_DECL) receiving the filter coefficients must be specified!"
#endif

#ifdef COEFF_NAMESPACE
namespace COEFF_NAMESPACE {
#endif

#define ARM_MATH_CM7
#include "arm_math.h"

constexpr auto MAX_AMPLITUDE_FILTER = 0.30408403;
constexpr auto BETA = 0.80;
constexpr auto SPAN = 8;
constexpr auto SPS = 4;
constexpr auto NUM_TAPS = SPAN * SPS + 1;

// approximations found by `sum(h(h > 0))` and `abs(sum(h(h < 0)))`
constexpr auto MAX_AMPLITUDE_OUT = 1.1100;
constexpr auto MIN_AMPLITUDE_OUT = 0.1100;

#ifndef PADDED
VAR_DECL {
	q15_t{128}, q15_t{124}, q15_t{-145}, q15_t{-250}, q15_t{63}, q15_t{314}, q15_t{-54}, q15_t{-606}, q15_t{-314}, q15_t{660}, q15_t{521}, q15_t{-1614}, 
	q15_t{-2943}, q15_t{1524}, q15_t{13307}, q15_t{26779}, q15_t{32767}, q15_t{26779}, q15_t{13307}, q15_t{1524}, q15_t{-2943}, q15_t{-1614}, q15_t{521}, q15_t{660}, 
	q15_t{-314}, q15_t{-606}, q15_t{-54}, q15_t{314}, q15_t{63}, q15_t{-250}, q15_t{-145}, q15_t{124}, q15_t{128}, 
};
#else
#undef PADDED
VAR_DECL {
	q15_t{0}, q15_t{128}, q15_t{124}, q15_t{-145}, q15_t{-250}, q15_t{63}, q15_t{314}, q15_t{-54}, q15_t{-606}, q15_t{-314}, q15_t{660}, q15_t{521}, 
	q15_t{-1614}, q15_t{-2943}, q15_t{1524}, q15_t{13307}, q15_t{26779}, q15_t{32767}, q15_t{26779}, q15_t{13307}, q15_t{1524}, q15_t{-2943}, q15_t{-1614}, q15_t{521}, 
	q15_t{660}, q15_t{-314}, q15_t{-606}, q15_t{-54}, q15_t{314}, q15_t{63}, q15_t{-250}, q15_t{-145}, q15_t{124}, q15_t{128}, 
};
#endif

#ifdef COEFF_NAMESPACE
}
#undef COEFF_NAMESPACE
#endif
