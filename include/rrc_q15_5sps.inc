/*
	This file was auto-generated by "filter_params_generator_nicer.m".
	It contains the filter coefficients for an rrc filter (parameters listed below).
*/

#ifndef VAR_DECL
#error "The declaration of the variable (VAR_DECL) receiving the filter coefficients must be specified!"
#endif

#ifdef COEFF_NAMESPACE
namespace COEFF_NAMESPACE {
#endif

#define ARM_MATH_CM7
#include "arm_math.h"

constexpr auto MAX_AMPLITUDE_FILTER = 0.24259566;
constexpr auto BETA = 0.80;
constexpr auto SPAN = 6;
constexpr auto SPS = 5;
constexpr auto NUM_TAPS = SPAN * SPS + 1;

// approximations found by `sum(h(h > 0))` and `abs(sum(h(h < 0)))`
constexpr auto MAX_AMPLITUDE_OUT = 1.0958;
constexpr auto MIN_AMPLITUDE_OUT = 0.0958;

#ifndef PADDED
VAR_DECL {
	q15_t{63}, q15_t{305}, q15_t{167}, q15_t{-314}, q15_t{-638}, q15_t{-314}, q15_t{487}, q15_t{831}, q15_t{-157}, q15_t{-2101}, q15_t{-2943}, q15_t{-4}, 
	q15_t{7920}, q15_t{19012}, q15_t{28837}, q15_t{32767}, q15_t{28837}, q15_t{19012}, q15_t{7920}, q15_t{-4}, q15_t{-2943}, q15_t{-2101}, q15_t{-157}, q15_t{831}, 
	q15_t{487}, q15_t{-314}, q15_t{-638}, q15_t{-314}, q15_t{167}, q15_t{305}, q15_t{63}, 
};
#else
#undef PADDED
VAR_DECL {
	q15_t{0}, q15_t{63}, q15_t{305}, q15_t{167}, q15_t{-314}, q15_t{-638}, q15_t{-314}, q15_t{487}, q15_t{831}, q15_t{-157}, q15_t{-2101}, q15_t{-2943}, 
	q15_t{-4}, q15_t{7920}, q15_t{19012}, q15_t{28837}, q15_t{32767}, q15_t{28837}, q15_t{19012}, q15_t{7920}, q15_t{-4}, q15_t{-2943}, q15_t{-2101}, q15_t{-157}, 
	q15_t{831}, q15_t{487}, q15_t{-314}, q15_t{-638}, q15_t{-314}, q15_t{167}, q15_t{305}, q15_t{63}, 
};
#endif

#ifdef COEFF_NAMESPACE
}
#undef COEFF_NAMESPACE
#endif
