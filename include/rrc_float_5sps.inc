/*
	This file was auto-generated by "filter_params_generator_nicer.m".
	It contains the filter coefficients for an rrc filter (parameters listed below).
*/

#ifndef VAR_DECL
#error "The declaration of the variable (VAR_DECL) receiving the filter coefficients must be specified!"
#endif

#ifdef COEFF_NAMESPACE
namespace COEFF_NAMESPACE {
#endif

constexpr auto BETA = 0.80;
constexpr auto SPAN = 6;
constexpr auto SPS = 5;
constexpr auto NUM_TAPS = SPAN * SPS + 1;

// approximations found by `sum(h(h > 0))` and `abs(sum(h(h < 0)))`
constexpr auto MAX_AMPLITUDE_OUT = 1.0958;
constexpr auto MIN_AMPLITUDE_OUT = 0.0958;

VAR_DECL {
	0.0004670180f, 0.0022571456f, 0.0012361104f, -0.0023284039f, -0.0047254354f, -0.0023222237f, 0.0036039325f, 0.0061512472f, -0.0011611384f, -0.0155574481f, 
	-0.0217856709f, -0.0000293462f, 0.0586397806f, 0.1407563926f, 0.2135002100f, 0.2425956589f, 0.2135002100f, 0.1407563926f, 0.0586397806f, -0.0000293462f, 
	-0.0217856709f, -0.0155574481f, -0.0011611384f, 0.0061512472f, 0.0036039325f, -0.0023222237f, -0.0047254354f, -0.0023284039f, 0.0012361104f, 0.0022571456f, 
	0.0004670180f, 
};

#ifdef COEFF_NAMESPACE
}
#undef COEFF_NAMESPACE
#endif
