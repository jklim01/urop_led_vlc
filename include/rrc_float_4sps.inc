/*
	This file was auto-generated by "filter_params_generator_nicer.m".
	It contains the filter coefficients for an rrc filter (parameters listed below).
*/

#ifndef VAR_DECL
#error "The declaration of the variable (VAR_DECL) receiving the filter coefficients must be specified!"
#endif

#ifdef COEFF_NAMESPACE
namespace COEFF_NAMESPACE {
#endif

constexpr auto MAX_AMPLITUDE_OUT = 1.1100;
constexpr auto MIN_AMPLITUDE_OUT = 0.1100;
constexpr auto BETA = 0.80;
constexpr auto SPAN = 8;
constexpr auto SPS = 4;

constexpr auto NUM_TAPS = SPAN * SPS + 1;
VAR_DECL {
	0.0011911152f, 0.0011521153f, -0.0013481304f, -0.0023166222f, 0.0005853885f, 0.0029110302f, -0.0005043186f, -0.0056238181f, -0.0029108152f, 0.0061275159f, 
	0.0048348911f, -0.0149774985f, -0.0273074739f, 0.0141413911f, 0.1234908583f, 0.2485123556f, 0.3040840316f, 0.2485123556f, 0.1234908583f, 0.0141413911f, 
	-0.0273074739f, -0.0149774985f, 0.0048348911f, 0.0061275159f, -0.0029108152f, -0.0056238181f, -0.0005043186f, 0.0029110302f, 0.0005853885f, -0.0023166222f, 
	-0.0013481304f, 0.0011521153f, 0.0011911152f, 
};

#ifdef COEFF_NAMESPACE
}
#undef COEFF_NAMESPACE
#endif
